## arch/arm/mach-owl/Kconfig
```kconfig
if ARCH_OWL

choice
        prompt "Actions Semi Owl SoC Variant"
        optional

config MACH_S900
        bool "Actions Semi S900 SoC"
        select ARM64

config MACH_S700
        bool "Actions Semi S700 SoC"
        select ARM64

config MACH_S500
        bool "Actions Semi S500 SoC"
        select CPU_V7A
        select TIMER
        select OWL_TIMER

endchoice

config SYS_TEXT_BASE
        default 0x11000000 if MACH_S900 || MACH_S700
        default 0x08000040 if MACH_S500

config SYS_CONFIG_NAME
        default "owl-s900" if MACH_S900 || MACH_S700
        default "owl-s500" if MACH_S500

config SYS_SOC
        default "s900" if MACH_S900
        default "s700" if MACH_S700
        default "s500" if MACH_S500

endif
```

## configs/roseapplepi_defconfig
```kconfig
CONFIG_ARM=y
CONFIG_ARCH_OWL=y
CONFIG_ENV_SIZE=0x2000
CONFIG_MACH_S500=y
CONFIG_IDENT_STRING="\nRoseapplePi"
CONFIG_DEFAULT_DEVICE_TREE="s500-roseapplepi"
CONFIG_DISTRO_DEFAULTS=y
CONFIG_BOOTDELAY=5
CONFIG_USE_BOOTARGS=y
CONFIG_BOOTARGS="console=ttyOWL2,115200n8"
# CONFIG_DISPLAY_CPUINFO is not set
# CONFIG_DISPLAY_BOARDINFO is not set
CONFIG_SYS_PROMPT="U-Boot => "
CONFIG_CMD_MD5SUM=y
CONFIG_CMD_MEMINFO=y
CONFIG_CMD_CACHE=y
CONFIG_CMD_TIMER=y
```
